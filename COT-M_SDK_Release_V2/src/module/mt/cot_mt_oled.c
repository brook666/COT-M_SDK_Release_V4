/**
* @file         cot_mt_oled.c
* @brief        This header describes the functions that handle the serial port.
* @details      This is the detail description.
* @author       wende.wu
* @date         2017-06-01
* @version      V0.1
* @par Copyright (c):  Copyright (c) 2017 by COTiot Instruments, Inc.
* @par History:
*   version: author, date, desc\n
*/


/***************************************************************************************************
 * INCLUDES
 ***************************************************************************************************/
#include <stdio.h>
#include <stdint.h>
#include <stdbool.h>
#include <string.h>
#include "OSAL.h"
#include "OSAL_Memory.h"
#include "vfs.h"
#include "iic.h"
#include "error.h"
#include "cot_mt_oled.h"
#include "am_mcu_apollo.h"
#include "am_bsp.h"
#include "am_util.h"

/***************************************************************************************************
 * MACROS
 ***************************************************************************************************/

/***************************************************************************************************
 * CONSTANTS
 ***************************************************************************************************/

#define OLED_IIC_ADDR           0x3C   //   // oled iic address
#define OLED_WRITE_COMMAND      0x00
#define OLED_WRITE_DATA         0x40


const uint8_t ASC_F6x8[][6] =
{
    0x00, 0x00, 0x00, 0x00, 0x00, 0x00,// sp
    0x00, 0x00, 0x00, 0x2f, 0x00, 0x00,// !
    0x00, 0x00, 0x07, 0x00, 0x07, 0x00,// "
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    0x14, 0x14, 0x14, 0x14, 0x14, 0x14,// horiz lines
    #if 0
    0x40, 0x40, 0x00, 0x00, 0x00, 0x00,// RSSI  1
    0x00, 0x00, 0x00, 0x00, 0x00, 0x00,//
    
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    0x78, 0x78, 0x7C, 0x7C, 0x00, 0x00,//  
   #else
    0x40, 0x00, 0x00, 0x00, 0x00, 0x00,// RSSI  1
    0x00, 0x00, 0x00, 0x00, 0x00, 0x00,//
    
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    0x78, 0x00, 0x7C, 0x00, 0x00, 0x00,//  

   #endif
};

/****************************************8*16的点阵************************************/
const uint8_t ASC_F8x16[]=	  
{
  0x00,0x00,0x00,0x00,0x00,0x00,0x00,0x00,0x00,0x00,0x00,0x00,0x00,0x00,0x00,0x00,// 0
  0x00,0x00,0x00,0xF8,0x00,0x00,0x00,0x00,0x00,0x00,0x00,0x33,0x30,0x00,0x00,0x00,//! 1
  0x00,0x10,0x0C,0x06,0x10,0x0C,0x06,0x00,0x00,0x00,0x00,0x00,0x00,0x00,0x00,0x00,//" 2
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  0x00,0x06,0x01,0x01,0x02,0x02,0x04,0x04,0x00,0x00,0x00,0x00,0x00,0x00,0x00,0x00,//~ 94
};

/***************************16*16的点阵字体取模方式：共阴——列行式——逆向输出*********/
const uint8_t CN_F16_16[] =
{

    0x00,0x00,0x10,0x10,0x10,0xFF,0x10,0x10,0x10,0x10,0xFF,0x10,0x10,0x10,0x00,0x00,
    0x00,0x04,0x84,0x44,0x24,0x17,0x04,0x04,0x04,0x04,0x17,0x24,0x44,0x84,0x04,0x00,//共 0
    
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    0x00,0xFF,0x08,0x10,0x08,0x07,0x08,0x08,0x08,0x08,0xFF,0x08,0x08,0x08,0x08,0x00,//阵3 
};

const uint8_t PictureCode_COT[] =
{
    0x00,0x00,0x00,0x00,0x00,0x00,0x00,0x00,0x00,0x00,0x00,0x00,0x00,0x00,0x00,0x00,0x00,0x00,0x00,0x00,0x00,0x00,0x00,0x00,0x00,0x00,0x00,0x00,0x00,0x00,0x00,0x00,
    0x00,0x00,0x00,0x00,0x00,0x00,0x00,0x00,0x00,0x00,0x00,0x00,0x00,0x00,0x00,0x00,0x00,0x00,0x00,0x00,0x00,0x00,0x00,0x00,0x00,0x00,0x00,0x00,0x00,0x00,0x00,0x00,
    0x00,0x00,0x00,0x00,0x00,0x00,0x00,0x00,0x00,0x00,0x00,0x00,0x00,0x00,0x00,0x00,0x00,0x00,0x00,0x00,0x00,0x00,0x00,0x00,0x00,0x00,0x00,0x00,0x00,0x00,0x00,0x00,
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    0x00,0x00,0x00,0x00,0x00,0x00,0x00,0x00,0x00,0x00,0x00,0x00,0x00,0x00,0x00,0x00,0x00,0x00,0x00,0x00,0x00,0x00,0x00,0x00,0x00,0x00,0x00,0x00,0x00,0x00,0x00,0x00,
};

/***************************************************************************************************
 *                                         GLOBAL VARIABLES
 ***************************************************************************************************/
/* cot application protocal parameters */


/***************************************************************************************************
 *                                          LOCAL FUNCTIONS
 ***************************************************************************************************/



/***************************************************************************************************
 *                                          PUBLIC FUNCTIONS
 ***************************************************************************************************/


void I2C_WriteByte(int32_t iic_fd,uint8_t Command,uint8_t Data)//写命令
{
    uint8_t tmp_buf[2];
    tmp_buf[0] = Command;
    tmp_buf[1] = Data;
    if(iic_fd != 0)
        write(iic_fd,tmp_buf, 2);
}

void WriteCmd(int32_t iic_fd,uint8_t I2C_Command)//写命令
{
    I2C_WriteByte(iic_fd,OLED_WRITE_COMMAND, I2C_Command);
}

void WriteDat(int32_t iic_fd,uint8_t I2C_Data)//写数据
{
	I2C_WriteByte(iic_fd,OLED_WRITE_DATA, I2C_Data);
}

void OLED_SetPos(int32_t iic_fd,uint8_t x,uint8_t y) //设置起始点坐标
{ 
	WriteCmd(iic_fd,0xb0+y);
	WriteCmd(iic_fd,((x&0xf0)>>4)|0x10);
	WriteCmd(iic_fd,(x&0x0f)|0x01);
}


/** 
* @name: OLED_register_init 
* This function deal with the oled register init.
* @param[in]    none
* @param[out]   none 
* @retval  ERR_SUCCESS  0
* @retval  do not deal the event   >0
* @par identifier
*      reserve
* @par other
*      none
* @par ModifyBlog
*      create by wende.wu on 2017-06-15
*/
void OLED_register_init( )
{
    int32_t iic_fd = 0;  
        
    iic_fd = open(PATH_IIC0,0);
    if( iic_fd <= 0 )   return ;
    ioctl(iic_fd,IIC_SLAVE_ADDR,OLED_IIC_ADDR);
	am_util_delay_ms(100); // Waiting  
	
	WriteCmd(iic_fd,0xAE); //display off
	WriteCmd(iic_fd,0x20); //Set Memory Addressing Mode	
	WriteCmd(iic_fd,0x10); //00,Horizontal Addressing Mode;01,Vertical Addressing Mode;10,Page Addressing Mode (RESET);11,Invalid
	WriteCmd(iic_fd,0xb0); //Set Page Start Address for Page Addressing Mode,0-7
	WriteCmd(iic_fd,0xc8); //Set COM Output Scan Direction
	WriteCmd(iic_fd,0x00); //---set low column address
	WriteCmd(iic_fd,0x10); //---set high column address
	WriteCmd(iic_fd,0x40); //--set start line address
	WriteCmd(iic_fd,0x81); //--set contrast control register
	WriteCmd(iic_fd,0xff); //亮度调节 0x00~0xff
	WriteCmd(iic_fd,0xa1); //--set segment re-map 0 to 127
	WriteCmd(iic_fd,0xa6); //--set normal display
	WriteCmd(iic_fd,0xa8); //--set multiplex ratio(1 to 64)
	WriteCmd(iic_fd,0x3F); //
	WriteCmd(iic_fd,0xa4); //0xa4,Output follows RAM content;0xa5,Output ignores RAM content
	WriteCmd(iic_fd,0xd3); //-set display offset
	WriteCmd(iic_fd,0x00); //-not offset
	WriteCmd(iic_fd,0xd5); //--set display clock divide ratio/oscillator frequency
	WriteCmd(iic_fd,0xf0); //--set divide ratio
	WriteCmd(iic_fd,0xd9); //--set pre-charge period
	WriteCmd(iic_fd,0x22); //
	WriteCmd(iic_fd,0xda); //--set com pins hardware configuration
	WriteCmd(iic_fd,0x12);
	WriteCmd(iic_fd,0xdb); //--set vcomh
	WriteCmd(iic_fd,0x20); //0x20,0.77xVcc
	WriteCmd(iic_fd,0x8d); //--set DC-DC enable
	WriteCmd(iic_fd,0x14); //
	WriteCmd(iic_fd,0xaf); //--turn on oled panel
    close(iic_fd);	
}




uint8_t OLED_ShowShiny(uint8_t Dat)
{
    return ~Dat;
}



/** 
* @name: OLED_Fill 
* This function handles oled display lattice.
* @param[in]    lattice  lattice
* @param[out]   none 
* @retval  ERR_SUCCESS  0
* @retval  do not deal the event   >0
* @par identifier
*      reserve
* @par other
*      none
* @par ModifyBlog
*      create by wende.wu on 2017-06-15
*/
void OLED_Fill(uint8_t lattice)//全屏填充
{
	uint8_t m,n;
    int32_t iic_fd = 0;  
        
    iic_fd = open(PATH_IIC0,0);
    if( iic_fd <= 0 )   return ;
    ioctl(iic_fd,IIC_SLAVE_ADDR,OLED_IIC_ADDR);
    
	for(m=0;m<8;m++)
	{
		WriteCmd(iic_fd,0xb0+m);		//page0-page1
		WriteCmd(iic_fd,0x00);		//low column start address
		WriteCmd(iic_fd,0x10);		//high column start address
		for(n=0;n<128;n++)
		{
			WriteDat(iic_fd,lattice);
		}
	}
    close(iic_fd);
}

/** 
* @name: OLED_CLS 
* This function handles oled clear the display.
* @param[in]    none
* @param[out]   none 
* @retval  ERR_SUCCESS  0
* @retval  do not deal the event   >0
* @par identifier
*      reserve
* @par other
*      none
* @par ModifyBlog
*      create by wende.wu on 2017-06-15
*/
void OLED_CLS()//清屏
{
	OLED_Fill(0x00);
}

void oled_line_cls( uint8_t m )
{
	uint8_t n;
    int32_t iic_fd = 0;  
        
    iic_fd = open(PATH_IIC0,0);
    if( iic_fd <= 0 )   return ;
    ioctl(iic_fd,IIC_SLAVE_ADDR,OLED_IIC_ADDR);
    
	WriteCmd(iic_fd,0xb0+m);		//page0-page1
	WriteCmd(iic_fd,0x00);		//low column start address
	WriteCmd(iic_fd,0x10);		//high column start address
	for(n=0;n<128;n++)
	{
		WriteDat(iic_fd,0x00);
	}

    close(iic_fd);
}

/** 
* @name: OLED_ShowStr6x8 
* This function deal with the oled Show asc String.
* @param[in]   x    coordinates      x0:0~127
* @param[in]   y    coordinates      y0:0~7
* @param[in]   *asc asc String
* @param[out]  none 
* @retval  ERR_SUCCESS  0
* @retval  do not deal the event   >0
* @par identifier
*      reserve
* @par other
*      none
* @par ModifyBlog
*      create by wende.wu on 2017-06-15
*/
void OLED_ShowStr6x8(uint8_t shiny,uint8_t x,uint8_t y,uint8_t asc[])
{
	unsigned char c = 0,i = 0,j = 0;
    int32_t iic_fd = 0;  
        
    iic_fd = open(PATH_IIC0,0);
    if( iic_fd <= 0 )   return ;
    ioctl(iic_fd,IIC_SLAVE_ADDR,OLED_IIC_ADDR);
	while(asc[j] != '\0')
	{
		c = asc[j] - 0x20;
		if(x >= 126) //if(x > 126)
		{
			x = 0;
			y++;
		}
		OLED_SetPos(iic_fd,x,y);
        if(shiny == OLED_SHOWLIGHT)
        {
            for(i=0;i<6;i++)
		        WriteDat(iic_fd,OLED_ShowShiny(ASC_F6x8[c][i]));
        }    
        else
        {
            for(i=0;i<6;i++)
		        WriteDat(iic_fd,ASC_F6x8[c][i]);
        }
		x += 6;
		j++;
	}
    close(iic_fd);
}


/** 
* @name: OLED_ShowStr8x16 
* This function deal with the oled Show asc String.
* @param[in]   x    coordinates      x0:0~127
* @param[in]   y    coordinates      y0:0~7
* @param[in]   *asc asc String
* @param[out]  none 
* @retval  ERR_SUCCESS  0
* @retval  do not deal the event   >0
* @par identifier
*      reserve
* @par other
*      none
* @par ModifyBlog
*      create by wende.wu on 2017-06-15
*/
void OLED_ShowStr8x16(uint8_t shiny,uint8_t x,uint8_t y,uint8_t asc[])
{
	uint8_t c = 0,i = 0,j = 0;
    uint8_t len = 8;
    int32_t iic_fd = 0;  
        
    iic_fd = open(PATH_IIC0,0);
    if( iic_fd <= 0 )      return ;
    ioctl(iic_fd,IIC_SLAVE_ADDR,OLED_IIC_ADDR);
	while(asc[j] != '\0')
	{
		c = asc[j] - 0x20;
		if(x >= 128)
		{
			x = 0;
			y+=2;//y++;
		}
		OLED_SetPos(iic_fd,x,y);
        if(x == 120) len = 7;
        else    len = 8;
        for(i=0;i < len;i++)
        {
            if(shiny == OLED_SHOWLIGHT)
		        WriteDat(iic_fd,OLED_ShowShiny(ASC_F8x16[c*16+i]));
            else
                WriteDat(iic_fd,ASC_F8x16[c*16+i]);
        } 
		OLED_SetPos(iic_fd,x,y+1);
        for(i=0;i < len;i++)
        {
            if(shiny == OLED_SHOWLIGHT)
			    WriteDat(iic_fd,OLED_ShowShiny(ASC_F8x16[c*16+i+8]));
            else
                WriteDat(iic_fd,ASC_F8x16[c*16+i+8]);
        } 
		x += 8;
		j++;
	}
    close(iic_fd);
}


/** 
* @name: OLED_ShowCN_16x16 
* This function deal with the oled Show Chinese characters.
* @param[in]   x    coordinates      x0:0~127
* @param[in]   y    coordinates      y0:0~7
* @param[in]   *CN_16x16   Chinese characters
* @param[out]  none 
* @retval  ERR_SUCCESS  0
* @retval  do not deal the event   >0
* @par identifier
*      reserve
* @par other
*      none
* @par ModifyBlog
*      create by wende.wu on 2017-06-15
*/
void OLED_ShowCN_16x16(uint8_t shiny,uint8_t x,uint8_t y,const uint8_t *CN_16x16)
{
	uint8_t wm = 0,len = 16;
    int32_t iic_fd = 0;  
        
    iic_fd = open(PATH_IIC0,0);
    if(iic_fd <= 0 )  return ;
    ioctl(iic_fd,IIC_SLAVE_ADDR,OLED_IIC_ADDR);
	OLED_SetPos(iic_fd,x , y);
    if(x == 112) len = 15;
        else    len = 16;
    for(wm = 0;wm < len;wm++)
	{
	    if(shiny == OLED_SHOWLIGHT)
		    WriteDat(iic_fd,OLED_ShowShiny(CN_16x16[wm]));
        else
            WriteDat(iic_fd,CN_16x16[wm]);
	}
	OLED_SetPos(iic_fd,x,y + 1);
    for(wm = 0;wm < len;wm++)
	{
	    if(shiny == OLED_SHOWLIGHT)
		    WriteDat(iic_fd,OLED_ShowShiny(CN_16x16[wm + 16]));
        else
            WriteDat(iic_fd,CN_16x16[wm + 16]);
	}
    close(iic_fd);
}


/** 
* @name: OLED_DrawBMP 
* This function handles the output of the picture.
* @param[in]   x0   Starting point coordinates      x0:0~127
* @param[in]   y0   Starting point coordinates      y0:0~7
* @param[in]   x1   End the coordinates             x1:1~128
* @param[in]   y1   End the coordinates             y1:1~8
* @param[in]   *BMP picture
* @param[out]  none 
* @retval  ERR_SUCCESS  0
* @retval  do not deal the event   >0
* @par identifier
*      reserve
* @par other
*      none
* @par ModifyBlog
*      create by wende.wu on 2017-06-15
*/
void OLED_DrawBMP(uint8_t x0,uint8_t y0,uint8_t x1,uint8_t y1,const uint8_t BMP[])
{
	uint16_t j = 0;
	uint8_t x,y;
    int32_t iic_fd = 0;  
        
    iic_fd = open(PATH_IIC0,0);
    if( iic_fd <= 0 )   return ;
    ioctl(iic_fd,IIC_SLAVE_ADDR,OLED_IIC_ADDR);

    if(y1%8==0)  y = y1/8;
    else         y = y1/8 + 1;
    for(y=y0;y<y1;y++)
    {
        OLED_SetPos(iic_fd,x0,y);
        for(x=x0;x<x1;x++)
        {
        	WriteDat(iic_fd,BMP[j++]);
        }
    }
    close(iic_fd);
}


/** 
* @name: cot_mt_oled_init 
* This function deal with the oled init.
* @param[in]   none
* @param[out]  none 
* @retval  ERR_SUCCESS  0
* @retval  do not deal the event   >0
* @par identifier
*      reserve
* @par other
*      none
* @par ModifyBlog
*      create by wende.wu on 2017-06-15
*/
int32_t cot_mt_oled_init( void )
{
    iic_init_module();
    OLED_register_init();
    

    OLED_DrawBMP(0,0,128,8,PictureCode_COT); 
    am_util_delay_ms(1000);
    OLED_CLS();//清屏  

    #if 0
    OLED_CLS();//清屏        
    am_util_delay_ms(1000);
    OLED_Fill(0xFF);//全屏点亮
    am_util_delay_ms(1000);
    OLED_Fill(0x00);//全屏灭
        OLED_ShowStr6x8(OLED_SHOWLIGHT,0,0,"1234567890abcdef1234567890abcdef");        
        OLED_ShowStr8x16(OLED_SHOWLIGHT,0,2,"1234567890ABCDEF1234567890ABCDEF");
        OLED_ShowCN_16x16(OLED_SHOWLIGHT,0,4,CN_F16_16);
        OLED_ShowCN_16x16(OLED_SHOWLIGHT,16,4,CN_F16_16 + 32);
        OLED_ShowCN_16x16(OLED_SHOWLIGHT,32,4,CN_F16_16 + 32 * 2);
        OLED_ShowCN_16x16(OLED_SHOWLIGHT,112,4,CN_F16_16 + 32 * 3);
        
        am_util_delay_ms(10000);
        am_util_delay_ms(10000);
        
        OLED_ShowStr6x8(OLED_SHOWDARK,0,0,"1234567890abcdef1234567890abcdef");
        OLED_ShowStr8x16(OLED_SHOWDARK,0,2,"1234567890ABCDEF1234567890ABCDEF");
        OLED_ShowCN_16x16(OLED_SHOWDARK,0,4,CN_F16_16);
        OLED_ShowCN_16x16(OLED_SHOWDARK,16,4,CN_F16_16 + 32);
        OLED_ShowCN_16x16(OLED_SHOWDARK,32,4,CN_F16_16 + 32 * 2);
        OLED_ShowCN_16x16(OLED_SHOWDARK,48,4,CN_F16_16 + 32 * 3);

        //OLED_DrawBMP(0,0,128,8,PictureCode); 
        
        
        am_util_delay_ms(6000);
        OLED_Fill(0x00);//全屏灭
    #endif
    
    return 0;
}




